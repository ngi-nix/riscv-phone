## recipes-bsp/u-boot/rvphone/cl-imx8/board/rvphone/cl-imx8/Kconfig
```kconfig
if TARGET_RVPHONE_CL_IMX8

config SYS_BOARD
	default "cl-imx8"

config SYS_VENDOR
	default "rvphone"

config SYS_CONFIG_NAME
	default "cl-imx8"

choice
	prompt "RAM Volume select"
	default RAM_2G
	help
	 This option configures 2G RAM only

config RAM_1G
	bool "RAM_1G"
	help
	 This option configures 1G RAM only

config RAM_2G
	bool "RAM_2G"
	help
	 This option configures 2G RAM only

endchoice

endif
```

## sdkconfig.defaults
```kconfig
CONFIG_LWIP_PPP_SUPPORT=y
CONFIG_LWIP_PPP_NOTIFY_PHASE_SUPPORT=y
CONFIG_LWIP_PPP_PAP_SUPPORT=y
CONFIG_LWIP_PPP_CHAP_SUPPORT=y
```

## yocto/meta-bsp-rvphone/conf/layer.conf
```bitbake
# We have a conf and classes directory, append to BBPATH
BBPATH .= ":${LAYERDIR}"

# We have a recipes directory containing .bb and .bbappend files, add to BBFILES
BBFILES += "${LAYERDIR}/recipes-*/*/*.bb \
            ${LAYERDIR}/recipes-*/*/*.bbappend"

BBFILE_COLLECTIONS += "rvphone-bsp"
BBFILE_PATTERN_rvphone-bsp := "^${LAYERDIR}/"
BBFILE_PRIORITY_rvphone-bsp = "9"

LAYERSERIES_COMPAT_rvphone-bsp = "sumo"
```

## yocto/meta-bsp-rvphone/conf/machine/cl-imx8.conf
```bitbake
#@TYPE: Machine
#@NAME: rvPhone cl-imx8
#@SOC: i.MX8MQ
#@DESCRIPTION: Machine configuration for rvPhone cl-imx8
#@MAINTAINER: majstor <majstor@majstor.org>

MACHINEOVERRIDES =. "mx8:mx8m:mx8mq:"

require conf/machine/include/imx-base.inc
require conf/machine/include/arm/arch-arm64.inc

MACHINE_FEATURES += " pci wifi bluetooth "

KERNEL_DEVICETREE = "rvphone/cl-imx8.dtb"

UBOOT_CONFIG ??= "cfg"
UBOOT_CONFIG[d1] = "cl-imx8_d1_defconfig,sdcard"
UBOOT_CONFIG[d2] = "cl-imx8_d2_defconfig,sdcard"
UBOOT_CONFIG[mfgtool] = "cl-imx8_defconfig"
SPL_BINARY = "spl/u-boot-spl.bin"

# Set DDR FIRMWARE
DDR_FIRMWARE_NAME = " \
	lpddr4_pmu_train_1d_dmem.bin \
	lpddr4_pmu_train_1d_imem.bin \
	lpddr4_pmu_train_2d_dmem.bin \
	lpddr4_pmu_train_2d_imem.bin \
"

# Set u-boot DTB
UBOOT_DTB_NAME = "cl-imx8.dtb"

# Set imx-mkimage boot target
IMXBOOT_TARGETS = "flash_evk flash_evk_no_hdmi"

# Set Serial console
SERIAL_CONSOLE = "115200 ttymxc2"

IMAGE_BOOTLOADER = "imx-boot"

BOOT_SPACE = "65536"

LOADADDR = ""
UBOOT_SUFFIX = "bin"
UBOOT_MAKE_TARGET = ""
IMX_BOOT_SEEK = "33"

MACHINE_FIRMWARE = " \
	linux-firmware-iwlwifi-8265 \
	linux-firmware-ibt \
"

OPTEE_BIN_EXT = "8mq"
PLATFORM_FLAVOR_cl-som-imx8 = "mx8mqevk"
```

## yocto/meta-bsp-rvphone/recipes-bsp/u-boot/rvphone/cl-imx8/configs/cl-imx8_defconfig
```kconfig
CONFIG_ARM=y
CONFIG_ARCH_IMX8M=y
CONFIG_SYS_TEXT_BASE=0x40200000
CONFIG_SYS_MALLOC_F_LEN=0x2000
CONFIG_TARGET_RVPHONE_CL_IMX8=y
CONFIG_IMX_OPTEE=y
CONFIG_DEFAULT_DEVICE_TREE="cl-imx8"
CONFIG_LOCALVERSION="-rvphone-cl-imx8-CFG"
CONFIG_FIT=y
CONFIG_SPL_LOAD_FIT=y
CONFIG_SYS_EXTRA_OPTIONS="IMX_CONFIG=arch/arm/mach-imx/spl_sd.cfg"
CONFIG_DEFAULT_FDT_FILE="cl-imx8.dtb"
CONFIG_ARCH_MISC_INIT=y
CONFIG_SPL=y
CONFIG_SPL_BOARD_INIT=y
CONFIG_HUSH_PARSER=y
CONFIG_CMD_MEMINFO=y
CONFIG_CMD_MEMTEST=y
CONFIG_CMD_GPIO=y
CONFIG_CMD_I2C=y
CONFIG_CMD_CACHE=y
CONFIG_CMD_PMIC=y
CONFIG_CMD_REGULATOR=y
CONFIG_CMD_EXT2=y
CONFIG_CMD_EXT4=y
CONFIG_CMD_EXT4_WRITE=y
CONFIG_CMD_FAT=y
CONFIG_CMD_FS_GENERIC=y
CONFIG_OF_CONTROL=y
CONFIG_ENV_IS_IN_MMC=y
CONFIG_IMX8M_LPDDR4=y
CONFIG_SAVED_DRAM_TIMING_BASE=0x40000000
CONFIG_DM_GPIO=y
CONFIG_DM_I2C=y
CONFIG_SYS_I2C_MXC=y
CONFIG_DM_MMC=y
CONFIG_DM_ETH=y
CONFIG_PINCTRL=y
CONFIG_PINCTRL_IMX8M=y
CONFIG_DM_PMIC=y
CONFIG_DM_PMIC_PFUZE100=y
CONFIG_DM_REGULATOR=y
CONFIG_DM_REGULATOR_PFUZE100=y
CONFIG_DM_REGULATOR_FIXED=y
CONFIG_DM_REGULATOR_GPIO=y
CONFIG_DM_THERMAL=y
CONFIG_LED=y
CONFIG_LED_GPIO=y
CONFIG_LED_STATUS=y
CONFIG_LED_STATUS_GPIO=y
CONFIG_LED_STATUS_BOARD_SPECIFIC=y
CONFIG_LED_STATUS0=y
CONFIG_LED_STATUS_BIT=12
CONFIG_LED_STATUS_STATE=2
```
